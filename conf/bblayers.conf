## meta-amit/conf/distro/amit-systemd.conf
```bitbake
require conf/distro/poky.conf

DISTRO = "amit-systemd"
DISTRO_NAME = "AMIT Bullet Systemd Distribution"
DISTRO_VERSION = "1.0"

INIT_MANAGER = "systemd"
```

## meta-amit/conf/distro/amit-sysvinit.conf
```bitbake
require conf/distro/poky.conf

DISTRO = "amit-sysvinit"
DISTRO_NAME = "AMIT Bullet SysVinit Distribution"
DISTRO_VERSION = "1.0"

INIT_MANAGER = "sysvinit"
```

## meta-observability/conf/layer.conf
```bitbake
BBPATH .= ":${LAYERDIR}"

BBFILES += " \
    ${LAYERDIR}/recipes-*/*/*.bb \
    ${LAYERDIR}/recipes-*/*/*.bbappend \
"

BBFILE_COLLECTIONS += "observability"
BBFILE_PATTERN_observability = "^${LAYERDIR}/"
BBFILE_PRIORITY_observability = "6"

LAYERDEPENDS_observability = "core"
LAYERSERIES_COMPAT_observability = "kirkstone"
```
